/ {
	amba_pl: amba_pl {
		ranges;
		compatible = "simple-bus";
		#address-cells = <1>;
		#size-cells = <1>;
		firmware-name = "ZYNQ_TOP_wrapper2.bit.bin";
		misc_clk_0: misc_clk_0 {
			compatible = "fixed-clock";
			clock-frequency = <100000000>;
			#clock-cells = <0>;
		};
		ps_axi_ctrl_new_0: ps_axi_ctrl_new@43c00000 {
			compatible = "xlnx,ps-axi-ctrl-new-1.0";
			xlnx,common-i-num = <0>;
			xlnx,s00-axi-data-width = <32>;
			xlnx,rable = <0>;
			xlnx,ip-name = "ps_axi_ctrl_new";
			reg = <0x43c00000 0x10000>;
			clocks = <&misc_clk_0>;
			xlnx,common-o-num = <0>;
			xlnx,edk-iptype = "PERIPHERAL";
			status = "okay";
			xlnx,s00-axi-addr-width = <8>;
			clock-names = "s00_axi_aclk";
			xlnx,name = "ps_axi_ctrl_new_0";
		};
	};
};
